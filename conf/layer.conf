## conf/layer.conf
```bitbake
# We have a conf and classes directory, add to BBPATH
BBPATH .= ":${LAYERDIR}"

# We have recipes-* directories, add to BBFILES
BBFILES += "${LAYERDIR}/recipes-*/*/*.bb \
            ${LAYERDIR}/recipes-*/*/*.bbappend"

BBFILE_COLLECTIONS += "meta-commod"
BBFILE_PATTERN_meta-commod = "^${LAYERDIR}/"
BBFILE_PRIORITY_meta-commod = "11"

LAYERSERIES_COMPAT_meta-commod = "thud"
```
